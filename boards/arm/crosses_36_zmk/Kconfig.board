## boards/arm/crosses_36_zmk/Kconfig.board
```kconfig
config BOARD_CROSSES_36_ZMK_LEFT
    bool "crosses-36-zmk left"
    depends on SOC_NRF52840_QIAA

config BOARD_CROSSES_36_ZMK_RIGHT
    bool "crosses-36-zmk right"
    depends on SOC_NRF52840_QIAA
```

## config/west.yml
```yaml
manifest:
  defaults:
    revision: v0.3
  remotes:
  - name: zmkfirmware
    url-base: https://github.com/zmkfirmware
  - name: Good-Great-Grand-Wonderful
    url-base: https://github.com/Good-Great-Grand-Wonderful
  projects:
  - name: zmk
    remote: zmkfirmware
    import: app/west.yml
  - name: crosses-36-zmk-template
    url: https://github.com/Good-Great-Grand-Wonderful/crosses-36-zmk-template
    revision: main
    path: modules/crosses-36-zmk-template
  - name: gggw-zmk-keebs
    remote: Good-Great-Grand-Wonderful
    revision: main
    import: config/west.yml
  self:
    path: config
```
